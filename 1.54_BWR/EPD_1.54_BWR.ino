/* 
 *  This example code is for 1.54" Spectra EPD of Pervasive Displays Inc (PDi) on EXT2 board which is verified by Arduino M0 Pro/TI LaunchPad EK-TM4C123GXL, MSP-EXP430F5529LP.
 *  And it should be able to be compiled on Arduino/Energia IDE supported boards.
 *  You will need a level shifter 5V --> 3V if using Arduino Due or Arduino Uno to work with EXT2 board.  
 *  For more information about PDi EPD products and EXT2 board, please visit 
 *  https://www.pervasivedisplays.com/products/ and https://www.pervasivedisplays.com/product/epd-extension-kit-gen-2-ext2/
 */

#include <SPI.h>
#if defined(ENERGIA)
// Valid pins for LaunchPad on Energia
#define SCL_PIN 7  // EXT2 BOARD J5 pin 7
#define SDA_PIN 15  // EXT2 BOARD J5 pin 15
#define CS_PIN 19  // EXT2 BOARD J5 pin 19
#define DC_PIN 9   // EXT2 BOARD J5 pin 9
#define RESET_PIN 10 // EXT2 BOARD J5 pin 10
#define BUSY_PIN 8  // EXT2 BOARD J5 pin 8
#define PNLON_PIN 11 // EXT2 BOARD J5 pin 11
#define BS_PIN 17        //EXT2 BOARD J5 pin 17
//#define CSS_PIN 2     // EXT2 BOARD J5 pin 2 Slave CSB only required of 9.7"/12" with one 24pin FPC operation
//#define CSS_PIN 13     // EXT2 BOARD J5 pin 13 Slave CSB only required of 9.7/12" with 34pin FFC bridge board(2FPC design) operation

// SPI protocl setup
void sendIndexData( uint8_t index, const uint8_t *data, uint32_t len ) {
  SPI.begin (); 
  SPI.setDataMode(SPI_MODE3);
  SPI.setClockDivider(SPI_CLOCK_DIV32);
  SPI.setBitOrder(MSBFIRST);
  digitalWrite( DC_PIN, LOW );      //DC Low
  digitalWrite( CS_PIN, LOW );      //CS Low
  delayMicroseconds(500);
  SPI.transfer( index );
  delayMicroseconds(500);
  digitalWrite( CS_PIN, HIGH );     //CS High
  digitalWrite( DC_PIN, HIGH );     //DC High
  digitalWrite( CS_PIN, LOW );      //CS Low
  delayMicroseconds(500);
  for ( int i = 0; i < len; i++ ) SPI.transfer( data[ i ] );
  delayMicroseconds(500);
  digitalWrite( CS_PIN, HIGH );     //CS High
}

#else
// Valid pins for Arduino board, like M0 Pro
#define SCL_PIN 13   //EXT2 BOARD J5 pin 7
#define SDA_PIN 12   //EXT2 BOARD J5 pin 15
#define CS_PIN 11    //EXT2 BOARD J5 pin 19 Master CSB
#define DC_PIN 10    //EXT2 BOARD J5 pin 9
#define RESET_PIN 9  //EXT2 BOARD J5 pin 10
#define BUSY_PIN 8   //EXT2 BOARD J5 pin 8
#define PNLON_PIN 7  //EXT2 BOARD J5 pin 11
#define BS_PIN 4        //EXT2 BOARD J5 pin 17
//#define CSS_PIN 6    //EXT2 BOARD J5 pin 2 Slave CSB
//#define CSS_PIN 5     // EXT2 BOARD J5 pin 13 Slave CSB only required of 9.7/12" with 34pin FFC bridge board(2FPC design) operation

//EXT2 BOARD J5 pin 20 connected to GND
//EXT2 BOARD J5 pin 1 connected to 3V3

// Software SPI setup
void softwareSpi( uint8_t data ) {
  for ( int i = 0; i < 8; i++ ) {
    if ((( data >> (7 - i) ) & 0x01 ) == 1 ) digitalWrite( SDA_PIN, HIGH );
    else digitalWrite( SDA_PIN, LOW );
    digitalWrite( SCL_PIN, HIGH );
    digitalWrite( SCL_PIN, LOW );
  }
}

// Software SPI protocl setup
void sendIndexData( uint8_t index, const uint8_t *data, uint32_t len ) {
  digitalWrite( DC_PIN, LOW );      //DC Low
  digitalWrite( CS_PIN, LOW );      //CS Low
  softwareSpi( index );
  digitalWrite( CS_PIN, HIGH );     //CS High
  digitalWrite( DC_PIN, HIGH );     //DC High
  digitalWrite( CS_PIN, LOW );      //CS High
  for ( int i = 0; i < len; i++ ) softwareSpi( data[ i ] );
  digitalWrite( CS_PIN, HIGH );     //CS High
}
#endif

extern const uint8_t blackBuffer [];
extern const uint8_t redBuffer [];

//setup function runs once on startup
void setup() {            
  Serial.begin( 115200 ); //begin a Serial link
  pinMode( PNLON_PIN, OUTPUT);
  pinMode( SCL_PIN, OUTPUT );
  pinMode( SDA_PIN, OUTPUT );
  pinMode( CS_PIN, OUTPUT );
  pinMode( DC_PIN, OUTPUT );
  pinMode( RESET_PIN, OUTPUT );
  pinMode( BS_PIN, OUTPUT );
  digitalWrite( PNLON_PIN, HIGH );    //PANEL_ON# = 1
  digitalWrite( BS_PIN, LOW );
  pinMode( BUSY_PIN, INPUT );         //All Pins 0
  delay( 5 );
  digitalWrite( RESET_PIN, HIGH );    //RES# = 1
  delay( 5 ); 
  digitalWrite( RESET_PIN, LOW );
  delay( 10 );
  digitalWrite( RESET_PIN, HIGH );
  delay( 5 );
  digitalWrite( CS_PIN, HIGH );       //CS# = 1

  uint8_t data9[] = { 0x0e };         
  sendIndexData( 0x00, data9, 1 );    //Soft-reset
  delay( 5 );
  
  uint8_t data7[] = { 0x19 };   
  sendIndexData( 0xe5, data7, 1 );    //Input Temperature: 25C
  uint8_t data6[] = { 0x02 };         
  sendIndexData( 0xe0, data6, 1 );    //Active Temperature  
  uint8_t data5[] = { 0xcf, 0x8d };         
  sendIndexData( 0x00, data5, 2 );    //PSR

// Send image data
  sendIndexData( 0x10, blackBuffer, 2888 ); //First frame
  sendIndexData( 0x13, redBuffer, 2888 );   //Second frame
  delay( 50 );
  
  uint8_t data8[] = { 0x00 };
  sendIndexData( 0x04, data8, 1 );    //Power on
  delay( 5 );
  while( digitalRead( BUSY_PIN ) != HIGH );
  sendIndexData( 0x12, data8, 1 );    //Display Refresh
  delay( 5 );
  while( digitalRead( BUSY_PIN ) != HIGH );
  sendIndexData( 0x02, data8, 1 );    //Turn off DC/DC
  while( digitalRead( BUSY_PIN ) != HIGH );
  digitalWrite( DC_PIN, LOW );
  digitalWrite( CS_PIN, LOW );
  digitalWrite( SDA_PIN, LOW );
  digitalWrite( SCL_PIN, LOW );
  digitalWrite( RESET_PIN, LOW );
}

void loop() {
}

const uint8_t blackBuffer [] = { 
0x00,0x00,0x00,0x00,0x00,0x00,0x00,0x00,0x00,0x00,0x00,0x00,0x00,0x00,0x00,0x7f,0xff,0xff,0xff, // 1
0x00,0x00,0x00,0x00,0x00,0x00,0x00,0x00,0x00,0x00,0x00,0x00,0x00,0x00,0x00,0x7f,0xff,0xff,0xff, // 2
0x00,0x00,0x00,0x00,0x00,0x00,0x00,0x00,0x00,0x00,0x00,0x00,0x00,0x00,0x00,0x7f,0xff,0xff,0xff, // 3
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0x00,0x00,0x00,0x00,0x00,0x00,0x00,0x00,0x00,0x00,0x00,0x00,0x00,0x00,0x00,0x7f,0xff,0xff,0xff, // 152
};

const uint8_t redBuffer [] = {
0x00,0x00,0x00,0x00,0x00,0x00,0x00,0x00,0x00,0x00,0x00,0x00,0x00,0x00,0x00,0x00,0x00,0x00,0x00, // 153
0x00,0x00,0x00,0x00,0x00,0x00,0x00,0x00,0x00,0x00,0x00,0x00,0x00,0x00,0x00,0x00,0x00,0x00,0x00, // 154
0x00,0x00,0x00,0x00,0x00,0x00,0x00,0x00,0x00,0x00,0x00,0x00,0x00,0x00,0x00,0x00,0x00,0x00,0x00, // 155
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0x00,0x00,0x00,0x00,0x00,0x00,0x00,0x00,0x00,0x00,0x00,0x00,0x00,0x00,0x00,0x00,0x00,0x00,0x00, // 304
};
